## linux-sunxi/drivers/misc/sunxi-clk-prepare/Kconfig
```kconfig
config SUNXI_CLK_PREPARE
	tristate "allwinnertech clk related modules prepare driver"
	depends on COMMON_CLK && ARCH_SUN8IW7
	default n
	help
	  This is a driver for manager module clk's relation.
```

## linux-sunxi/drivers/net/wireless/88w8977/Kconfig
```kconfig
config 88W8977
	tristate "Marvell 8977 SDIO WiFi"
	---help---
	  Help message of Marvell 8977
```

## linux-sunxi/drivers/uav_sensors/Kconfig
```kconfig
#
# Hardware monitoring chip drivers configuration
#

menuconfig UAV_SENSORS
	tristate "UAV SENSORS support"
	default y
	help
	  uav sensors support

if UAV_SENSORS

config UAV_SENSORS_MPU6050
	tristate "mpu6050"
	depends on I2C
	help
		6-axis sensor include acc and gyro

config UAV_SENSORS_FBM320
	tristate "fbm320"
	depends on I2C
	help
		barometer sensor

config UAV_SENSORS_HMC5883
	tristate "hmc5883"
	depends on I2C
	help
		mag sensor

config UAV_SENSORS_QMC5883
	tristate "qmc5883"
	depends on I2C
	help
		mag sensor

config UAV_SENSORS_KS103
	tristate "ks103"
	depends on I2C
	help
		sonar sensor

config UAV_SENSORS_GPS_POWER
	tristate "gps_power"
	help
		gps_power interface,use echo 1 > /sys/gps_power/gps_power to control

config UAV_SENSORS_LIS3MDL
	tristate "lis3mdl"
	depends on I2C
	help
		3-axis mag sensor

endif #UAV_SENSORS
```

## linux-sunxi/sound/soc/sunxi/i2s0/Kconfig
```kconfig
config SND_SUNXI_SOC_I2S0_INTERFACE
	tristate "SoC i2s0 interface for SUNXI chips"
	depends on ARCH_SUN8IW3 || ARCH_SUN8IW5 || ARCH_SUN8IW1 || ARCH_SUN8IW6 || ARCH_SUN9IW1
	select SND_SOC_DMAENGINE_PCM
	default n
	help
	  Say Y or M if you want to add support for codecs attached to
	  the SUNXI AC97, I2S or PCM interface. You will also need
	  to select the audio interfaces to support below.

config I2S0_FOR_ASTAR_DM_PATCH
	tristate "patch for ASTAR_DM"
	depends on ARCH_SUN8IW5
	default n
	help
	  Say Y for patch for SUN8IW5 ASTAR DM

config I2S0_FOR_ASTAR_NOMA_PATCH
	tristate "patch for ASTAR_NOMA"
	depends on ARCH_SUN8IW5
	default n
	help
	  Say Y for patch for SUN8IW5 ASTAR NOMA
```

## sunxi-pack/allwinner/generic/image/Config.in
```kconfig
config SUNXI_SD_BOOT_PARTSIZE
	int "Boot (SD Card) filesystem partition size (in MB)"
	default 4
```
